## firmware/main/Kconfig.projbuild
```kconfig
menu "RNBO ESP32-S3 bring-up"
config RNBO_S3_ALLOCATION_WATCH
    bool "Count detached initialization and audio-owner heap operations"
    default y
    select HEAP_USE_HOOKS
    help
        Successful heap allocations by the audio owner fault its final output.
        Other tasks and interrupts are excluded. The RNBO arena's internal
        allocations are counted separately by the module wrapper.
config RNBO_S3_HEADLESS
    bool "XIAO stereo sink (no display/codec)"
    default n
config RNBO_S3_I2S_BCLK
    int "XIAO I2S bit clock GPIO"
    default 7
    range 0 48
    depends on RNBO_S3_HEADLESS
config RNBO_S3_I2S_WS
    int "XIAO I2S word select GPIO"
    default 8
    range 0 48
    depends on RNBO_S3_HEADLESS
config RNBO_S3_I2S_DOUT
    int "XIAO I2S data out GPIO"
    default 9
    range 0 48
    depends on RNBO_S3_HEADLESS
config RNBO_S3_USB_MIDI_HOST
    bool "Experimental USB MIDI1 host (replaces USB console; use Wi-Fi)"
    default n
    depends on RNBO_S3_HEADLESS
    help
        Requires a USB host adapter, suitable VBUS supply and a class-compliant
        MIDI1 controller. Build explicitly with tools/build_firmware.py. Do not
        enable the USB Serial/JTAG console in this variant.
endmenu
```

## loader-spike/firmware/sdkconfig.defaults
```kconfig
CONFIG_ESPTOOLPY_FLASHMODE_QIO=y
CONFIG_ESP_DEFAULT_CPU_FREQ_MHZ_240=y
CONFIG_SPIRAM=y
CONFIG_SPIRAM_MODE_OCT=y
CONFIG_SPIRAM_SPEED_80M=y
CONFIG_SPIRAM_USE_MALLOC=y
CONFIG_SPIRAM_MALLOC_RESERVE_INTERNAL=65536
CONFIG_ESP_CONSOLE_USB_SERIAL_JTAG=y
CONFIG_FREERTOS_HZ=1000
CONFIG_COMPILER_OPTIMIZATION_PERF=y
CONFIG_COMPILER_CXX_EXCEPTIONS=n
CONFIG_COMPILER_CXX_RTTI=n
CONFIG_ESP_MAIN_TASK_STACK_SIZE=10240
CONFIG_ESP32S3_INSTRUCTION_CACHE_32KB=y
CONFIG_ESP32S3_DATA_CACHE_64KB=y
CONFIG_ESP32S3_DATA_CACHE_LINE_64B=y
CONFIG_ELF_LOADER=y
CONFIG_ELF_LOADER_LOAD_PSRAM=y
CONFIG_ELF_LOADER_LIBC_SYMBOLS=n
CONFIG_ELF_LOADER_ESPIDF_SYMBOLS=n
CONFIG_ELF_LOADER_CUSTOMER_SYMBOLS=n
CONFIG_ELF_DYNAMIC_LOAD_SHARED_OBJECT=n
CONFIG_ELF_LOADER_NUMBER_SYMBOLS=1
CONFIG_PARTITION_TABLE_CUSTOM=y
```

## module-sdk/cmake/dynamic/sdkconfig.defaults
```kconfig
CONFIG_ELF_LOADER=n
CONFIG_COMPILER_OPTIMIZATION_PERF=y
CONFIG_COMPILER_CXX_EXCEPTIONS=n
CONFIG_COMPILER_CXX_RTTI=n
```
